## main/Kconfig.projbuild
```kconfig
menu "Wi-Fi Configuration"

config WIFI_SSID
    string "Wi-Fi SSID"
    default "ssid"

config WIFI_PASS
    string "Wi-Fi Password"
    default "password"

endmenu

menu "OTA Configuration"

config GITHUB_USER
    string "Github Username"
    default "User"

config GITHUB_REPO
    string "Github Repository Name"
    default "Repo Name"

config BIN_FILENAME
    string "Filename of the firmware bin"
    default "firmware.bin"

  endmenu
```

## sdkconfig.defaults
```kconfig
CONFIG_PARTITION_TABLE_CUSTOM=y

# Flash size
CONFIG_ESPTOOLPY_FLASHSIZE_4MB=y

# Enable OTA updates
CONFIG_BOOTLOADER_APP_ROLLBACK_ENABLE=y
CONFIG_BOOTLOADER_APP_ANTI_ROLLBACK=n

CONFIG_PARTITION_TABLE_CUSTOM=y
CONFIG_PARTITION_TABLE_CUSTOM_FILENAME="partitions.csv"
CONFIG_PARTITION_TABLE_FILENAME="partitions.csv"
CONFIG_PARTITION_TABLE_OFFSET=0x8000
CONFIG_BT_ENABLED=y
```
